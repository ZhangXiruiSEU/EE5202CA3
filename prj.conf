## CMakeLists.txt
```
# SPDX-License-Identifier: Apache-2.0

cmake_minimum_required(VERSION 3.20.0)
find_package(Zephyr REQUIRED HINTS $ENV{ZEPHYR_BASE})
project(lsm6dsl)

FILE(GLOB app_sources CONFIGURE_DEPENDS src/*.c)
target_sources(app PRIVATE
  ${app_sources}
  src/HARnet/network.c
  src/HARnet/network_data.c
)

target_include_directories(app PRIVATE
  src/HARnet
  src/HARnet/Inc
)

target_link_libraries(app PRIVATE
  ${CMAKE_CURRENT_SOURCE_DIR}/src/HARnet/Lib/NetworkRuntime1200_CM4_GCC.a
)
```

## prj.conf
```kconfig
CONFIG_STDOUT_CONSOLE=y
CONFIG_I2C=y
CONFIG_SPI=y
CONFIG_SENSOR=y
CONFIG_FPU=y
CONFIG_FP_HARDABI=y
CONFIG_LSM6DSL_TRIGGER_NONE=y
CONFIG_HTS221_ODR="1"
CONFIG_LIS3MDL_ODR="1.25"
CONFIG_LPS22HB_SAMPLING_RATE=1
CONFIG_CBPRINTF_FP_SUPPORT=y
CONFIG_MAIN_STACK_SIZE=6144
```

## src/main.c
```c
/*
 * matriculation numbers: A0328159W &  A0206327L
 * Copyright (c) 2018 STMicroelectronics
 *
 * SPDX-License-Identifier: Apache-2.0
 */

#include <zephyr/sys/printk.h>

#include "app_context.h"
#include "app_threads.h"
#include "har_task.h"
#include "lsm6dsl_fifo.h"
#include "sensor_drdy.h"

static struct app_context app = {
	.lsm6dsl_dev = DEVICE_DT_GET_ONE(st_lsm6dsl),
	.hts221_dev = DEVICE_DT_GET_ONE(st_hts221),
	.lis3mdl_dev = DEVICE_DT_GET_ONE(st_lis3mdl_magn),
	.lps22hb_dev = DEVICE_DT_GET_ONE(st_lps22hb_press),
	.har_status = 1,
};

/* These macros allocate and statically initialize the shared kernel objects. */
K_MUTEX_DEFINE(app_lock);
K_MUTEX_DEFINE(sensor_lock);
/* Fixed-depth producer/consumer queue from the accel thread to the HAR thread. */
K_MSGQ_DEFINE(accel_msgq, sizeof(struct accel_sample), ACCEL_QUEUE_DEPTH, 4);

static int init_devices(struct app_context *ctx)
{
	struct sensor_value accel_odr_attr = { .val1 = 26, .val2 = 0 };
	struct sensor_value gyro_odr_attr = { .val1 = 12, .val2 = 0 };

	if (!device_is_ready(ctx->lsm6dsl_dev)) {
		printk("sensor: device not ready.\n");
		return -ENODEV;
	}

	if (!device_is_ready(ctx->hts221_dev) || !device_is_ready(ctx->lis3mdl_dev) ||
	    !device_is_ready(ctx->lps22hb_dev)) {
		printk("aux sensor: device not ready.\n");
		return -ENODEV;
	}

	/*
	 * Keep the HAR input rate explicit in code: the model consumes a
	 * 26-sample accelerometer window once per second.
	 */
	if (sensor_attr_set(ctx->lsm6dsl_dev, SENSOR_CHAN_ACCEL_XYZ,
			    SENSOR_ATTR_SAMPLING_FREQUENCY, &accel_odr_attr) < 0) {
		printk("Cannot set sampling frequency for accelerometer.\n");
		return -EIO;
	}

	/*
	 * The gyroscope shares the LSM6DSL device but has its own channel ODR.
	 * Lower-rate auxiliary sensors keep their default ODRs from prj.conf.
	 */
	if (sensor_attr_set(ctx->lsm6dsl_dev, SENSOR_CHAN_GYRO_XYZ,
			    SENSOR_ATTR_SAMPLING_FREQUENCY, &gyro_odr_attr) < 0) {
		printk("Cannot set sampling frequency for gyro.\n");
		return -EIO;
	}

	return 0;
}

int main(void)
{
	if (init_devices(&app) < 0) {
		return 0;
	}

	if (har_init() < 0) {
		return 0;
	}

	if (sensor_drdy_init() < 0) {
		printk("DRDY helper init failed.\n");
		return 0;
	}

	if (lsm6dsl_fifo_init() < 0) {
		printk("LSM6DSL FIFO init failed.\n");
		return 0;
	}

	printk("HAR window: %d x %d accel samples\n", HAR_WINDOW_SAMPLES, HAR_AXES);
	app_threads_start(&app);

	while (1) {
		k_sleep(K_FOREVER);
	}

	return 0;
}
```

## src/app_context.h
```c
#ifndef APPLICATIONS_LSM6DSL_APP_CONTEXT_H_
#define APPLICATIONS_LSM6DSL_APP_CONTEXT_H_

#include <zephyr/device.h>
#include <zephyr/drivers/sensor.h>
#include <zephyr/kernel.h>
#include <stddef.h>
#include <stdint.h>

/* Spread 104 accel polls evenly across a 4 s major cycle. */
#define MAJOR_CYCLE_US 4000000ULL
#define ACCEL_EVENTS_PER_MAJOR 104U
#define ACCEL_INTERVAL_BASE_US (MAJOR_CYCLE_US / ACCEL_EVENTS_PER_MAJOR)
#define ACCEL_INTERVAL_REM_US (MAJOR_CYCLE_US % ACCEL_EVENTS_PER_MAJOR)
#define GYRO_PERIOD_US 80000ULL
#define MAG_PERIOD_US 800000ULL
#define ENV_PERIOD_US 1000000ULL
#define HAR_PERIOD_US 1000000ULL
#define PRINT_PERIOD_US 1000000ULL
#define STATUS_MSG_SIZE 384
#define HTS221_PHASE_US 200000ULL
#define LPS22HB_PHASE_US 400000ULL
#define LIS3MDL_PHASE_US 600000ULL
#define HAR_PHASE_US 900000ULL
#define PRINT_PHASE_US 950000ULL
#define HAR_WINDOW_SAMPLES 26
#define HAR_AXES 3
#define HAR_INPUT_SCALE_MG 4000.0f
#define ACCEL_QUEUE_DEPTH 128
#define URGENT_BLOCK_MIN_US 30000U
#define URGENT_BLOCK_MAX_US 50000U
#define URGENT_SLEEP_MIN_MS 250U
#define URGENT_SLEEP_MAX_MS 900U

#define URGENT_THREAD_PRIO 0
#define ACCEL_THREAD_PRIO 1
#define GYRO_THREAD_PRIO 2
#define AUX_THREAD_PRIO 3
#define HAR_THREAD_PRIO 4
#define PRINT_THREAD_PRIO 5

#define URGENT_STACK_SIZE 1024
#define SENSOR_STACK_SIZE 2048
#define HAR_STACK_SIZE 4096
#define PRINT_STACK_SIZE 2048

struct app_context {
	/* Device handles resolved from devicetree at build time. */
	const struct device *lsm6dsl_dev;
	const struct device *hts221_dev;
	const struct device *lis3mdl_dev;
	const struct device *lps22hb_dev;

	/* Latest sensor values published by the sensor threads. */
	struct sensor_value accel[3];
	struct sensor_value humidity;
	struct sensor_value temperature;
	struct sensor_value pressure;
	struct sensor_value gyro[3];
	struct sensor_value magnetic[3];

	/* Latest HAR inference timing and output state. */
	uint32_t har_cycles;
	uint64_t har_us;
	int har_status;
	float har_scores[3];
	size_t har_sample_count;

	/* Accelerometer buffering and scheduling diagnostics. */
	uint32_t accel_queue_drops;
	uint32_t accel_late_samples;
	uint32_t accel_max_late_us;

	/* Urgent external task diagnostics. */
	uint32_t urgent_events;
	uint32_t urgent_last_block_us;
};

struct accel_sample {
	struct sensor_value accel[3];
	uint64_t timestamp_us;
	uint32_t late_us;
};

/* Shared kernel objects are defined in main.c; these declarations do not allocate them. */
extern struct k_mutex app_lock;
extern struct k_mutex sensor_lock;
extern struct k_msgq accel_msgq;

static inline uint64_t app_now_us(void)
{
	return k_ticks_to_us_floor64(k_uptime_ticks());
}

static inline void app_sleep_until_us(uint64_t target_us)
{
	uint64_t current_us = app_now_us();

	if (current_us < target_us) {
		k_sleep(K_USEC((int32_t)(target_us - current_us)));
	}
}

#endif
```

## src/app_threads.c
```c
#include "app_threads.h"

#include <zephyr/sys/util.h>

#include "har_task.h"
#include "sensor_tasks.h"
#include "status.h"

K_THREAD_STACK_DEFINE(urgent_stack, URGENT_STACK_SIZE);
K_THREAD_STACK_DEFINE(accel_stack, SENSOR_STACK_SIZE);
K_THREAD_STACK_DEFINE(gyro_stack, SENSOR_STACK_SIZE);
K_THREAD_STACK_DEFINE(hts221_stack, SENSOR_STACK_SIZE);
K_THREAD_STACK_DEFINE(lis3mdl_stack, SENSOR_STACK_SIZE);
K_THREAD_STACK_DEFINE(lps22hb_stack, SENSOR_STACK_SIZE);
K_THREAD_STACK_DEFINE(har_stack, HAR_STACK_SIZE);
K_THREAD_STACK_DEFINE(print_stack, PRINT_STACK_SIZE);

static struct k_thread urgent_thread_data;
static struct k_thread accel_thread_data;
static struct k_thread gyro_thread_data;
static struct k_thread hts221_thread_data;
static struct k_thread lis3mdl_thread_data;
static struct k_thread lps22hb_thread_data;
static struct k_thread har_thread_data;
static struct k_thread print_thread_data;

static uint32_t pseudo_random32(void)
{
	static uint32_t state;

	if (state == 0U) {
		state = k_cycle_get_32() ^ 0xa5a55a5aU;
	}

	state = state * 1664525U + 1013904223U;
	return state;
}

static void accel_schedule_advance(uint64_t *next_accel_us, uint32_t *accel_remainder_accum)
{
	/* Use integer remainder accumulation to avoid long-term drift. */
	*next_accel_us += ACCEL_INTERVAL_BASE_US;
	*accel_remainder_accum += ACCEL_INTERVAL_REM_US;
	if (*accel_remainder_accum >= ACCEL_EVENTS_PER_MAJOR) {
		*next_accel_us += 1U;
		*accel_remainder_accum -= ACCEL_EVENTS_PER_MAJOR;
	}
}

static void accel_thread(void *p1, void *p2, void *p3)
{
	struct app_context *ctx = p1;
	uint64_t next_accel_us = app_now_us();
	uint32_t accel_remainder_accum = 0U;

	/* Zephyr thread entry points always receive three args; this thread only needs ctx. */
	ARG_UNUSED(p2);
	ARG_UNUSED(p3);

	while (1) {
		uint64_t current_us;
		uint32_t late_us = 0U;

		app_sleep_until_us(next_accel_us);
		current_us = app_now_us();
		if (current_us > next_accel_us) {
			late_us = (uint32_t)MIN(current_us - next_accel_us, UINT32_MAX);
		}

		task_accel_sample(ctx, current_us, late_us);
		accel_schedule_advance(&next_accel_us, &accel_remainder_accum);
	}
}

static void hts221_thread(void *p1, void *p2, void *p3)
{
	struct app_context *ctx = p1;
	uint64_t next_release_us = app_now_us() + HTS221_PHASE_US;

	ARG_UNUSED(p2);
	ARG_UNUSED(p3);

	while (1) {
		app_sleep_until_us(next_release_us);
		task_read_hts221(ctx);

		do {
			next_release_us += ENV_PERIOD_US;
		} while (app_now_us() >= next_release_us);
	}
}

static void gyro_thread(void *p1, void *p2, void *p3)
{
	struct app_context *ctx = p1;
	uint64_t next_release_us = app_now_us();

	ARG_UNUSED(p2);
	ARG_UNUSED(p3);

	while (1) {
		app_sleep_until_us(next_release_us);
		task_read_gyro(ctx);

		do {
			next_release_us += GYRO_PERIOD_US;
		} while (app_now_us() >= next_release_us);
	}
}

static void lis3mdl_thread(void *p1, void *p2, void *p3)
{
	struct app_context *ctx = p1;
	uint64_t next_release_us = app_now_us() + LIS3MDL_PHASE_US;

	ARG_UNUSED(p2);
	ARG_UNUSED(p3);

	while (1) {
		app_sleep_until_us(next_release_us);
		task_read_lis3mdl(ctx);

		do {
			next_release_us += MAG_PERIOD_US;
		} while (app_now_us() >= next_release_us);
	}
}

static void lps22hb_thread(void *p1, void *p2, void *p3)
{
	struct app_context *ctx = p1;
	uint64_t next_release_us = app_now_us() + LPS22HB_PHASE_US;

	ARG_UNUSED(p2);
	ARG_UNUSED(p3);

	while (1) {
		app_sleep_until_us(next_release_us);
		task_read_lps22hb(ctx);

		do {
			next_release_us += ENV_PERIOD_US;
		} while (app_now_us() >= next_release_us);
	}
}

static void har_thread(void *p1, void *p2, void *p3)
{
	struct app_context *ctx = p1;
	uint64_t next_release_us = app_now_us() + HAR_PHASE_US;

	ARG_UNUSED(p2);
	ARG_UNUSED(p3);

	while (1) {
		app_sleep_until_us(next_release_us);
		task_run_har_measure(ctx);

		do {
			next_release_us += HAR_PERIOD_US;
		} while (app_now_us() >= next_release_us);
	}
}

static void print_thread(void *p1, void *p2, void *p3)
{
	struct app_context *ctx = p1;
	uint64_t next_release_us = app_now_us() + PRINT_PHASE_US;

	ARG_UNUSED(p2);
	ARG_UNUSED(p3);

	while (1) {
		app_sleep_until_us(next_release_us);
		task_print_status(ctx);

		do {
			next_release_us += PRINT_PERIOD_US;
		} while (app_now_us() >= next_release_us);
	}
}

static void urgent_external_thread(void *p1, void *p2, void *p3)
{
	struct app_context *ctx = p1;

	ARG_UNUSED(p2);
	ARG_UNUSED(p3);

	while (1) {
		uint32_t rnd = pseudo_random32();
		uint32_t sleep_ms = URGENT_SLEEP_MIN_MS +
				    (rnd % (URGENT_SLEEP_MAX_MS - URGENT_SLEEP_MIN_MS + 1U));
		uint32_t block_us = URGENT_BLOCK_MIN_US +
				    (pseudo_random32() %
				     (URGENT_BLOCK_MAX_US - URGENT_BLOCK_MIN_US + 1U));

		k_sleep(K_MSEC(sleep_ms));

		k_mutex_lock(&app_lock, K_FOREVER);
		ctx->urgent_events++;
		ctx->urgent_last_block_us = block_us;
		k_mutex_unlock(&app_lock);

		k_busy_wait(block_us);
	}
}

void app_threads_start(struct app_context *ctx)
{
	/* Start the highest-priority CPU-blocking stress task immediately. */
	k_thread_create(&urgent_thread_data, urgent_stack, K_THREAD_STACK_SIZEOF(urgent_stack),
			urgent_external_thread, ctx, NULL, NULL,
			URGENT_THREAD_PRIO, 0, K_NO_WAIT);

	/* Keep 26 Hz accelerometer sampling ahead of all normal application work. */
	k_thread_create(&accel_thread_data, accel_stack, K_THREAD_STACK_SIZEOF(accel_stack),
			accel_thread, ctx, NULL, NULL, ACCEL_THREAD_PRIO, 0, K_NO_WAIT);

	/* Sample gyroscope at the next highest normal sensor priority. */
	k_thread_create(&gyro_thread_data, gyro_stack, K_THREAD_STACK_SIZEOF(gyro_stack),
			gyro_thread, ctx, NULL, NULL, GYRO_THREAD_PRIO, 0, K_NO_WAIT);

	/* Low-rate environmental and magnetometer sensors share the auxiliary priority. */
	k_thread_create(&hts221_thread_data, hts221_stack, K_THREAD_STACK_SIZEOF(hts221_stack),
			hts221_thread, ctx, NULL, NULL, AUX_THREAD_PRIO, 0, K_NO_WAIT);
	k_thread_create(&lis3mdl_thread_data, lis3mdl_stack, K_THREAD_STACK_SIZEOF(lis3mdl_stack),
			lis3mdl_thread, ctx, NULL, NULL, AUX_THREAD_PRIO, 0, K_NO_WAIT);
	k_thread_create(&lps22hb_thread_data, lps22hb_stack, K_THREAD_STACK_SIZEOF(lps22hb_stack),
			lps22hb_thread, ctx, NULL, NULL, AUX_THREAD_PRIO, 0, K_NO_WAIT);

	/* Run HAR after samples have been buffered, below all sensor acquisition threads. */
	k_thread_create(&har_thread_data, har_stack, K_THREAD_STACK_SIZEOF(har_stack),
			har_thread, ctx, NULL, NULL, HAR_THREAD_PRIO, 0, K_NO_WAIT);
			
	/* Keep blocking UART output at the lowest application priority. */
	k_thread_create(&print_thread_data, print_stack, K_THREAD_STACK_SIZEOF(print_stack),
			print_thread, ctx, NULL, NULL, PRINT_THREAD_PRIO, 0, K_NO_WAIT);
}
```

## src/app_threads.h
```c
#ifndef APPLICATIONS_LSM6DSL_APP_THREADS_H_
#define APPLICATIONS_LSM6DSL_APP_THREADS_H_

#include "app_context.h"

void app_threads_start(struct app_context *ctx);

#endif
```

## src/har_task.c
```c
#include "har_task.h"

#include <zephyr/sys/printk.h>
#include <zephyr/sys/util.h>
#include <string.h>

#include "HARnet/network.h"

STAI_NETWORK_CONTEXT_DECLARE(har_network_ctx, STAI_NETWORK_CONTEXT_SIZE);
static STAI_ALIGNED(8) uint8_t har_activations[STAI_NETWORK_ACTIVATIONS_SIZE_BYTES];
static float har_window[HAR_WINDOW_SAMPLES][HAR_AXES];
static float *har_input;
static float *har_output;
static size_t har_count;
static size_t har_write_index;

static float accel_to_model_input(const struct sensor_value *accel)
{
	/* Match the normalization used when the HAR model was trained. */
	return (float)sensor_ms2_to_mg(accel) / HAR_INPUT_SCALE_MG;
}

int har_init(void)
{
	stai_return_code rc;
	stai_ptr activations[] = { har_activations };
	stai_ptr inputs[STAI_NETWORK_IN_NUM];
	stai_ptr outputs[STAI_NETWORK_OUT_NUM];
	stai_size n_inputs;
	stai_size n_outputs;

	/* Resolve the generated model buffers once and reuse them forever. */
	rc = stai_network_init(har_network_ctx);
	if (rc != STAI_SUCCESS) {
		printk("HAR init failed: 0x%x\n", rc);
		return -EIO;
	}

	rc = stai_network_set_activations(har_network_ctx, activations, ARRAY_SIZE(activations));
	if (rc != STAI_SUCCESS) {
		printk("HAR activations setup failed: 0x%x\n", rc);
		return -EIO;
	}

	rc = stai_network_get_inputs(har_network_ctx, inputs, &n_inputs);
	if (rc != STAI_SUCCESS || n_inputs != STAI_NETWORK_IN_NUM) {
		printk("HAR input lookup failed: 0x%x\n", rc);
		return -EIO;
	}

	rc = stai_network_get_outputs(har_network_ctx, outputs, &n_outputs);
	if (rc != STAI_SUCCESS || n_outputs != STAI_NETWORK_OUT_NUM) {
		printk("HAR output lookup failed: 0x%x\n", rc);
		return -EIO;
	}

	har_input = (float *)inputs[0];
	har_output = (float *)outputs[0];

	return 0;
}

static bool har_push_sample(struct app_context *ctx, const struct sensor_value accel[3])
{
	float sample[HAR_AXES] = {
		accel_to_model_input(&accel[0]),
		accel_to_model_input(&accel[1]),
		accel_to_model_input(&accel[2]),
	};

	memcpy(har_window[har_write_index], sample, sizeof(sample));
	har_write_index = (har_write_index + 1U) % HAR_WINDOW_SAMPLES;

	if (har_count < HAR_WINDOW_SAMPLES) {
		har_count++;
	}

	k_mutex_lock(&app_lock, K_FOREVER);
	ctx->har_sample_count = har_count;
	k_mutex_unlock(&app_lock);

	/* Inference can only start once the rolling window is completely filled. */
	return har_count == HAR_WINDOW_SAMPLES;
}

static int har_run_inference_cached(struct app_context *ctx)
{
	stai_return_code rc;
	uint32_t start_cycles;
	uint32_t end_cycles;
	uint32_t elapsed_cycles;
	uint64_t elapsed_us;

	if (har_count < HAR_WINDOW_SAMPLES) {
		k_mutex_lock(&app_lock, K_FOREVER);
		ctx->har_status = 1;
		k_mutex_unlock(&app_lock);
		return 1;
	}

	/*
	 * The ring buffer wraps continuously, so rebuild a linear input tensor
	 * in oldest-to-newest order before invoking the network.
	 */
	for (size_t i = 0; i < HAR_WINDOW_SAMPLES; i++) {
		size_t src_index = (har_write_index + i) % HAR_WINDOW_SAMPLES;

		memcpy(&har_input[i * HAR_AXES], har_window[src_index], sizeof(har_window[0]));
	}

	start_cycles = k_cycle_get_32();
	rc = stai_network_run(har_network_ctx, STAI_MODE_SYNC);
	end_cycles = k_cycle_get_32();
	if (rc != STAI_SUCCESS) {
		printk("HAR inference failed: 0x%x\n", rc);
		k_mutex_lock(&app_lock, K_FOREVER);
		ctx->har_status = -EIO;
		k_mutex_unlock(&app_lock);
		return -EIO;
	}

	elapsed_cycles = end_cycles - start_cycles;
	elapsed_us = k_cyc_to_us_floor64(elapsed_cycles);
	k_mutex_lock(&app_lock, K_FOREVER);
	ctx->har_cycles = elapsed_cycles;
	ctx->har_us = elapsed_us;
	ctx->har_scores[0] = har_output[0];
	ctx->har_scores[1] = har_output[1];
	ctx->har_scores[2] = har_output[2];
	ctx->har_status = 0;
	k_mutex_unlock(&app_lock);
	return 0;
}

void task_run_har_measure(struct app_context *ctx)
{
	struct accel_sample sample;

	while (k_msgq_get(&accel_msgq, &sample, K_NO_WAIT) == 0) {
		(void)har_push_sample(ctx, sample.accel);
	}

	(void)har_run_inference_cached(ctx);
}
```

## src/har_task.h
```c
#ifndef APPLICATIONS_LSM6DSL_HAR_TASK_H_
#define APPLICATIONS_LSM6DSL_HAR_TASK_H_

#include "app_context.h"

int har_init(void);
void task_run_har_measure(struct app_context *ctx);

#endif
```

## src/lsm6dsl_fifo.c
```c
#include "lsm6dsl_fifo.h"

#include <zephyr/device.h>
#include <zephyr/devicetree.h>
#include <zephyr/drivers/i2c.h>
#include <zephyr/sys/byteorder.h>
#include <zephyr/sys/util.h>

#include "app_context.h"

/* FIFO threshold low byte. We clear it because this app polls instead of using a watermark. */
#define LSM6DSL_REG_FIFO_CTRL1 0x06

/* FIFO threshold high bits and related FIFO control bits. Also cleared for no watermark. */
#define LSM6DSL_REG_FIFO_CTRL2 0x07

/* FIFO decimation selector: chooses accel/gyro streams and their decimation. */
#define LSM6DSL_REG_FIFO_CTRL3 0x08

/* FIFO ODR and FIFO operating mode, such as bypass or stream mode. */
#define LSM6DSL_REG_FIFO_CTRL5 0x0A

/* FIFO unread level low byte; burst-read with STATUS2 to get the full level. */
#define LSM6DSL_REG_FIFO_STATUS1 0x3A

/* FIFO data output start register; burst reads consume samples from hardware FIFO. */
#define LSM6DSL_REG_FIFO_DATA_OUT_L 0x3E

/* Put every accel sample into FIFO; no accelerometer decimation. */
#define LSM6DSL_FIFO_XL_NO_DEC 1U

/* Do not store gyro samples in FIFO because HAR only needs acceleration. */
#define LSM6DSL_FIFO_GY_DISABLE 0U

/* FIFO output data rate code for 26 Hz. */
#define LSM6DSL_FIFO_26HZ 2U

/* FIFO mode code that keeps accepting new samples after it becomes non-empty. */
#define LSM6DSL_FIFO_STREAM_MODE 6U

/* FIFO mode code used to stop/reset FIFO before reprogramming it. */
#define LSM6DSL_FIFO_BYPASS_MODE 0U

/* One accel sample is X/Y/Z, each stored as one 16-bit FIFO word. */
#define LSM6DSL_FIFO_WORDS_PER_ACCEL_SAMPLE 3U

/* Default +-2g accel sensitivity from the LSM6DSL driver: 61 micro-g per LSB. */
#define LSM6DSL_ACCEL_SENSITIVITY_UG_PER_LSB 61LL

/*
 * Low-level I2C handle for the LSM6DSL devicetree node.
 *
 * DEVICE_DT_GET_ONE(st_lsm6dsl) gives the Zephyr sensor driver object used by
 * sensor_sample_fetch(). This i2c_dt_spec instead stores the I2C bus device and
 * slave address, which we need for direct FIFO register reads/writes.
 */
static const struct i2c_dt_spec lsm6dsl_i2c = I2C_DT_SPEC_GET(DT_INST(0, st_lsm6dsl));

/*
 * Write one LSM6DSL register through I2C.
 *
 * This file talks to FIFO registers directly because Zephyr's generic sensor
 * API does not expose a portable "drain all FIFO samples" call. The shared
 * sensor_lock keeps these direct I2C transfers from racing Zephyr driver calls
 * that access the same LSM6DSL device.
 */
static int fifo_reg_write(uint8_t reg, uint8_t value)
{
	int ret;

	k_mutex_lock(&sensor_lock, K_FOREVER);
	ret = i2c_reg_write_byte_dt(&lsm6dsl_i2c, reg, value);
	k_mutex_unlock(&sensor_lock);

	return ret;
}

/*
 * Read a consecutive register block from the LSM6DSL.
 *
 * FIFO status and FIFO data are both read as bursts. Reading FIFO_DATA_OUT_L
 * advances the sensor's hardware FIFO read pointer, so callers must only call
 * this when they intend to consume a sample.
 */
static int fifo_burst_read(uint8_t reg, uint8_t *buf, size_t len)
{
	int ret;

	k_mutex_lock(&sensor_lock, K_FOREVER);
	ret = i2c_burst_read_dt(&lsm6dsl_i2c, reg, buf, len);
	k_mutex_unlock(&sensor_lock);

	return ret;
}

/*
 * Convert one raw LSM6DSL accel axis from FIFO format into Zephyr's
 * sensor_value unit format. FIFO accel samples use the same raw scale as the
 * normal accel output registers.
 */
static void raw_accel_to_sensor_value(int16_t raw, struct sensor_value *value)
{
	/* Default LSM6DSL accel full-scale is 2g: 61 ug/LSB in Zephyr's driver. */
	sensor_ug_to_ms2((int64_t)raw * LSM6DSL_ACCEL_SENSITIVITY_UG_PER_LSB, value);
}

/*
 * Configure the LSM6DSL hardware FIFO for this application.
 *
 * The FIFO is accel-only because HAR only consumes acceleration. It runs at
 * the same 26 Hz rate as the accel sampling thread, so if the urgent thread
 * blocks the CPU for one or more periods, the sensor can still collect samples
 * internally until the accel thread gets CPU time again.
 */
int lsm6dsl_fifo_init(void)
{
	if (!i2c_is_ready_dt(&lsm6dsl_i2c)) {
		return -ENODEV;
	}

	/*
	 * Program FIFO for accel-only stream mode. The FIFO keeps sampling while
	 * the CPU is blocked, and the accel thread drains pending samples later.
	 */
	if (fifo_reg_write(LSM6DSL_REG_FIFO_CTRL5, LSM6DSL_FIFO_BYPASS_MODE) < 0) {
		return -EIO;
	}

	/* No explicit FIFO threshold; the accel thread polls and drains by count. */
	if (fifo_reg_write(LSM6DSL_REG_FIFO_CTRL1, 0U) < 0 ||
	    fifo_reg_write(LSM6DSL_REG_FIFO_CTRL2, 0U) < 0) {
		return -EIO;
	}

	/* Store accel data in FIFO without decimation; do not store gyro data. */
	if (fifo_reg_write(LSM6DSL_REG_FIFO_CTRL3,
			   (LSM6DSL_FIFO_GY_DISABLE << 3) | LSM6DSL_FIFO_XL_NO_DEC) < 0) {
		return -EIO;
	}

	/* Start FIFO stream mode at 26 Hz. */
	if (fifo_reg_write(LSM6DSL_REG_FIFO_CTRL5,
			   (LSM6DSL_FIFO_26HZ << 3) | LSM6DSL_FIFO_STREAM_MODE) < 0) {
		return -EIO;
	}

	return 0;
}

/*
 * Return how many complete accel samples are currently waiting in hardware FIFO.
 *
 * LSM6DSL reports FIFO level in 16-bit words. One accel sample is X/Y/Z, so it
 * consumes three FIFO words. Any incomplete tail is ignored until the next poll.
 */
int lsm6dsl_fifo_sample_count(uint16_t *sample_count)
{
	uint8_t status[2];
	uint16_t fifo_words;

	if (fifo_burst_read(LSM6DSL_REG_FIFO_STATUS1, status, sizeof(status)) < 0) {
		return -EIO;
	}

	fifo_words = (uint16_t)status[0] | ((uint16_t)(status[1] & 0x07U) << 8);
	*sample_count = fifo_words / LSM6DSL_FIFO_WORDS_PER_ACCEL_SAMPLE;

	return 0;
}

/*
 * Consume one accel sample from the LSM6DSL hardware FIFO.
 *
 * Each sample is 6 bytes: little-endian signed 16-bit X, Y, and Z. Calling this
 * repeatedly drains older samples first.
 */
int lsm6dsl_fifo_read_accel(struct sensor_value accel[3])
{
	uint8_t raw[6];

	if (fifo_burst_read(LSM6DSL_REG_FIFO_DATA_OUT_L, raw, sizeof(raw)) < 0) {
		return -EIO;
	}

	raw_accel_to_sensor_value((int16_t)sys_get_le16(&raw[0]), &accel[0]);
	raw_accel_to_sensor_value((int16_t)sys_get_le16(&raw[2]), &accel[1]);
	raw_accel_to_sensor_value((int16_t)sys_get_le16(&raw[4]), &accel[2]);

	return 0;
}
```

## src/lsm6dsl_fifo.h
```c
#ifndef APPLICATIONS_LSM6DSL_LSM6DSL_FIFO_H_
#define APPLICATIONS_LSM6DSL_LSM6DSL_FIFO_H_

#include <zephyr/drivers/sensor.h>
#include <stdint.h>

int lsm6dsl_fifo_init(void);
int lsm6dsl_fifo_sample_count(uint16_t *sample_count);
int lsm6dsl_fifo_read_accel(struct sensor_value accel[3]);

#endif
```

## src/sensor_drdy.c
```c
#include "sensor_drdy.h"

#include <zephyr/device.h>
#include <zephyr/devicetree.h>
#include <zephyr/drivers/i2c.h>
#include <zephyr/sys/printk.h>
#include <zephyr/sys/util.h>
#include <stdarg.h>
#include <string.h>

#include "app_context.h"

/* Keep DRDY accounting aligned with the app's 4 s major cycle. */
#define DRDY_WINDOW_US 4000000ULL

#define LSM6DSL_REG_STATUS_REG 0x1E
#define LSM6DSL_STATUS_GDA BIT(1)
#define LSM6DSL_STATUS_XLDA BIT(0)

#define HTS221_REG_STATUS 0x27
#define HTS221_STATUS_H_DA BIT(1)
#define HTS221_STATUS_T_DA BIT(0)

#define LIS3MDL_REG_STATUS 0x27
#define LIS3MDL_STATUS_ZYXOR BIT(7)
#define LIS3MDL_STATUS_ZYXDA BIT(3)

#define LPS22HB_REG_STATUS 0x27
#define LPS22HB_STATUS_P_OR BIT(5)
#define LPS22HB_STATUS_P_DA BIT(1)

#define ACCEL_EXPECTED_PER_WINDOW 104U
#define GYRO_EXPECTED_PER_WINDOW 50U
#define HTS221_EXPECTED_PER_WINDOW 4U
#define LIS3MDL_EXPECTED_PER_WINDOW 5U
#define LPS22HB_EXPECTED_PER_WINDOW 4U

struct drdy_counter {
	uint32_t captured;
	uint32_t duplicates;
	uint32_t overruns;
};

struct drdy_state {
	struct drdy_counter accel;
	struct drdy_counter gyro;
	struct drdy_counter hts221;
	struct drdy_counter lis3mdl;
	struct drdy_counter lps22hb;
	struct drdy_counter report_accel;
	struct drdy_counter report_gyro;
	struct drdy_counter report_hts221;
	struct drdy_counter report_lis3mdl;
	struct drdy_counter report_lps22hb;
	uint32_t accel_in;
	uint32_t report_accel_in;
	uint64_t window_start_us;
	uint64_t report_window_start_us;
	bool report_pending;
	bool initialized;
};

static const struct i2c_dt_spec lsm6dsl_i2c = I2C_DT_SPEC_GET(DT_INST(0, st_lsm6dsl));
static const struct i2c_dt_spec hts221_i2c = I2C_DT_SPEC_GET(DT_INST(0, st_hts221));
static const struct i2c_dt_spec lis3mdl_i2c = I2C_DT_SPEC_GET(DT_INST(0, st_lis3mdl_magn));
static const struct i2c_dt_spec lps22hb_i2c = I2C_DT_SPEC_GET(DT_INST(0, st_lps22hb_press));

static struct drdy_state drdy_state;
K_MUTEX_DEFINE(drdy_lock);

static void drdy_append_fmt(char *buf, size_t buf_size, size_t *offset, const char *fmt, ...)
{
	va_list args;
	int written;

	if (*offset >= buf_size) {
		return;
	}

	va_start(args, fmt);
	written = vsnprintk(buf + *offset, buf_size - *offset, fmt, args);
	va_end(args);

	if (written < 0) {
		return;
	}

	*offset += (size_t)written;
}

static int read_status_reg(const struct i2c_dt_spec *spec, uint8_t reg, uint8_t *value)
{
	int ret;

	k_mutex_lock(&sensor_lock, K_FOREVER);
	ret = i2c_reg_read_byte_dt(spec, reg, value);
	k_mutex_unlock(&sensor_lock);

	return ret;
}

static void update_counter(struct drdy_counter *counter, bool data_ready, bool overrun)
{
	/* A missing DRDY bit means this poll likely reread the previous sample. */
	if (data_ready) {
		counter->captured++;
	} else {
		counter->duplicates++;
	}

	if (overrun) {
		counter->overruns++;
	}
}

static void reset_current_counters(void)
{
	(void)memset(&drdy_state.accel, 0, sizeof(drdy_state.accel));
	(void)memset(&drdy_state.gyro, 0, sizeof(drdy_state.gyro));
	(void)memset(&drdy_state.hts221, 0, sizeof(drdy_state.hts221));
	(void)memset(&drdy_state.lis3mdl, 0, sizeof(drdy_state.lis3mdl));
	(void)memset(&drdy_state.lps22hb, 0, sizeof(drdy_state.lps22hb));
	drdy_state.accel_in = 0U;
}

static void close_elapsed_windows_locked(uint64_t now_us)
{
	if (!drdy_state.initialized ||
	    (now_us - drdy_state.window_start_us) < DRDY_WINDOW_US) {
		return;
	}

	/*
	 * Keep the report semantics fixed at 4 s. If the low-priority print
	 * thread is late, counters after the boundary belong to the next
	 * window instead of stretching the completed report to 5 s.
	 */
	if (!drdy_state.report_pending) {
		drdy_state.report_accel = drdy_state.accel;
		drdy_state.report_gyro = drdy_state.gyro;
		drdy_state.report_hts221 = drdy_state.hts221;
		drdy_state.report_lis3mdl = drdy_state.lis3mdl;
		drdy_state.report_lps22hb = drdy_state.lps22hb;
		drdy_state.report_accel_in = drdy_state.accel_in;
		drdy_state.report_window_start_us = drdy_state.window_start_us;
		drdy_state.report_pending = true;
	}

	reset_current_counters();

	do {
		drdy_state.window_start_us += DRDY_WINDOW_US;
	} while ((now_us - drdy_state.window_start_us) >= DRDY_WINDOW_US);
}

static uint32_t percent_x100(uint32_t captured, uint32_t expected)
{
	uint32_t missed = 0U;

	if (captured < expected) {
		missed = expected - captured;
	}

	return (uint32_t)(((uint64_t)missed * 10000ULL) / expected);
}

static void append_counter(char *buf, size_t buf_size, size_t *offset, const char *name,
			  const struct drdy_counter *counter, uint32_t expected)
{
	uint32_t miss_x100 = percent_x100(counter->captured, expected);

	if (*offset >= buf_size) {
		return;
	}

	drdy_append_fmt(buf, buf_size, offset, "%s=%u/%u d%u (%u.%02u%%)",
		       name,
		       counter->captured,
		       expected,
		       counter->duplicates,
		       miss_x100 / 100U,
		       miss_x100 % 100U);
}

int sensor_drdy_init(void)
{
	if (!i2c_is_ready_dt(&lsm6dsl_i2c) ||
	    !i2c_is_ready_dt(&hts221_i2c) ||
	    !i2c_is_ready_dt(&lis3mdl_i2c) ||
	    !i2c_is_ready_dt(&lps22hb_i2c)) {
		return -ENODEV;
	}

	k_mutex_lock(&drdy_lock, K_FOREVER);
	drdy_state.window_start_us = k_ticks_to_us_floor64(k_uptime_ticks());
	drdy_state.initialized = true;
	k_mutex_unlock(&drdy_lock);
	return 0;
}

void sensor_drdy_poll_accel(void)
{
	uint8_t status;
	int ret;

	ret = read_status_reg(&lsm6dsl_i2c, LSM6DSL_REG_STATUS_REG, &status);
	if (ret < 0) {
		return;
	}

	k_mutex_lock(&drdy_lock, K_FOREVER);
	if (!drdy_state.initialized) {
		k_mutex_unlock(&drdy_lock);
		return;
	}

	close_elapsed_windows_locked(k_ticks_to_us_floor64(k_uptime_ticks()));
	update_counter(&drdy_state.accel, (status & LSM6DSL_STATUS_XLDA) != 0U, false);
	k_mutex_unlock(&drdy_lock);
}

void sensor_drdy_poll_gyro(void)
{
	uint8_t status;
	int ret;

	ret = read_status_reg(&lsm6dsl_i2c, LSM6DSL_REG_STATUS_REG, &status);
	if (ret < 0) {
		return;
	}

	k_mutex_lock(&drdy_lock, K_FOREVER);
	if (!drdy_state.initialized) {
		k_mutex_unlock(&drdy_lock);
		return;
	}

	close_elapsed_windows_locked(k_ticks_to_us_floor64(k_uptime_ticks()));
	update_counter(&drdy_state.gyro, (status & LSM6DSL_STATUS_GDA) != 0U, false);
	k_mutex_unlock(&drdy_lock);
}

void sensor_drdy_poll_hts221(void)
{
	uint8_t status;
	bool ready;
	int ret;

	ret = read_status_reg(&hts221_i2c, HTS221_REG_STATUS, &status);
	if (ret < 0) {
		return;
	}

	k_mutex_lock(&drdy_lock, K_FOREVER);
	if (!drdy_state.initialized) {
		k_mutex_unlock(&drdy_lock);
		return;
	}

	close_elapsed_windows_locked(k_ticks_to_us_floor64(k_uptime_ticks()));
	ready = (status & (HTS221_STATUS_H_DA | HTS221_STATUS_T_DA)) != 0U;
	update_counter(&drdy_state.hts221, ready, false);
	k_mutex_unlock(&drdy_lock);
}

void sensor_drdy_poll_lis3mdl(void)
{
	uint8_t status;
	int ret;

	ret = read_status_reg(&lis3mdl_i2c, LIS3MDL_REG_STATUS, &status);
	if (ret < 0) {
		return;
	}

	k_mutex_lock(&drdy_lock, K_FOREVER);
	if (!drdy_state.initialized) {
		k_mutex_unlock(&drdy_lock);
		return;
	}

	close_elapsed_windows_locked(k_ticks_to_us_floor64(k_uptime_ticks()));
	update_counter(&drdy_state.lis3mdl,
		      (status & LIS3MDL_STATUS_ZYXDA) != 0U,
		      (status & LIS3MDL_STATUS_ZYXOR) != 0U);
	k_mutex_unlock(&drdy_lock);
}

void sensor_drdy_poll_lps22hb(void)
{
	uint8_t status;
	int ret;

	ret = read_status_reg(&lps22hb_i2c, LPS22HB_REG_STATUS, &status);
	if (ret < 0) {
		return;
	}

	k_mutex_lock(&drdy_lock, K_FOREVER);
	if (!drdy_state.initialized) {
		k_mutex_unlock(&drdy_lock);
		return;
	}

	close_elapsed_windows_locked(k_ticks_to_us_floor64(k_uptime_ticks()));
	update_counter(&drdy_state.lps22hb,
		      (status & LPS22HB_STATUS_P_DA) != 0U,
		      (status & LPS22HB_STATUS_P_OR) != 0U);
	k_mutex_unlock(&drdy_lock);
}

bool sensor_drdy_reserve_accel_in(uint64_t sample_us)
{
	bool accepted = false;

	k_mutex_lock(&drdy_lock, K_FOREVER);
	if (!drdy_state.initialized) {
		k_mutex_unlock(&drdy_lock);
		return false;
	}

	if (sample_us < drdy_state.window_start_us) {
		if (drdy_state.report_pending &&
		    sample_us >= drdy_state.report_window_start_us &&
		    sample_us < (drdy_state.report_window_start_us + DRDY_WINDOW_US) &&
		    drdy_state.report_accel_in < ACCEL_EXPECTED_PER_WINDOW) {
			drdy_state.report_accel_in++;
			accepted = true;
		}
		k_mutex_unlock(&drdy_lock);
		return accepted;
	}

	close_elapsed_windows_locked(sample_us);
	if (drdy_state.accel_in < ACCEL_EXPECTED_PER_WINDOW) {
		drdy_state.accel_in++;
		accepted = true;
	}
	k_mutex_unlock(&drdy_lock);
	return accepted;
}

bool sensor_drdy_report_ready(uint64_t now_us)
{
	bool ready;

	k_mutex_lock(&drdy_lock, K_FOREVER);
	close_elapsed_windows_locked(now_us);
	ready = drdy_state.initialized && drdy_state.report_pending;
	k_mutex_unlock(&drdy_lock);

	return ready;
}

void sensor_drdy_format_report(char *buf, size_t buf_size, uint64_t now_us)
{
	size_t len = 0;

	if (buf_size == 0U) {
		return;
	}

	buf[0] = '\0';
	k_mutex_lock(&drdy_lock, K_FOREVER);
	close_elapsed_windows_locked(now_us);
	if (!drdy_state.initialized || !drdy_state.report_pending) {
		k_mutex_unlock(&drdy_lock);
		return;
	}

	/* Compact report format keeps UART output short enough for 1 Hz printing. */
	drdy_append_fmt(buf, buf_size, &len, "drdy4s ");
	append_counter(buf, buf_size, &len, "a", &drdy_state.report_accel,
		      ACCEL_EXPECTED_PER_WINDOW);
	drdy_append_fmt(buf, buf_size, &len, " accel_in=%u", drdy_state.report_accel_in);
	drdy_append_fmt(buf, buf_size, &len, " ");
	append_counter(buf, buf_size, &len, "g", &drdy_state.report_gyro,
		      GYRO_EXPECTED_PER_WINDOW);
	drdy_append_fmt(buf, buf_size, &len, " ");
	append_counter(buf, buf_size, &len, "h", &drdy_state.report_hts221,
		      HTS221_EXPECTED_PER_WINDOW);
	drdy_append_fmt(buf, buf_size, &len, " ");
	append_counter(buf, buf_size, &len, "m", &drdy_state.report_lis3mdl,
		      LIS3MDL_EXPECTED_PER_WINDOW);
	drdy_append_fmt(buf, buf_size, &len, " ");
	append_counter(buf, buf_size, &len, "p", &drdy_state.report_lps22hb,
		      LPS22HB_EXPECTED_PER_WINDOW);
	drdy_append_fmt(buf, buf_size, &len, "\n");

	if (len >= buf_size) {
		buf[buf_size - 1U] = '\0';
	}

	drdy_state.report_pending = false;
	k_mutex_unlock(&drdy_lock);
}
```

## src/sensor_drdy.h
```c
#ifndef APPLICATIONS_LSM6DSL_SENSOR_DRDY_H_
#define APPLICATIONS_LSM6DSL_SENSOR_DRDY_H_

#include <zephyr/kernel.h>
#include <stddef.h>

int sensor_drdy_init(void);

/* Poll helpers sample each sensor's data-ready bit before the regular fetch. */
void sensor_drdy_poll_accel(void);
void sensor_drdy_poll_gyro(void);
void sensor_drdy_poll_hts221(void);
void sensor_drdy_poll_lis3mdl(void);
void sensor_drdy_poll_lps22hb(void);

/* Reserve one fixed-window accelerometer input slot for the HAR queue. */
bool sensor_drdy_reserve_accel_in(uint64_t sample_us);

/* Reports are emitted once per 4 s observation window. */
bool sensor_drdy_report_ready(uint64_t now_us);
void sensor_drdy_format_report(char *buf, size_t buf_size, uint64_t now_us);

#endif
```

## src/sensor_tasks.c
```c
#include "sensor_tasks.h"

#include <zephyr/sys/printk.h>
#include <string.h>

#include "lsm6dsl_fifo.h"
#include "sensor_drdy.h"

static int read_current_accel(const struct device *dev, struct sensor_value accel[3])
{
	int ret;

	k_mutex_lock(&sensor_lock, K_FOREVER);
	ret = sensor_sample_fetch_chan(dev, SENSOR_CHAN_ACCEL_XYZ);
	if (ret < 0) {
		k_mutex_unlock(&sensor_lock);
		printk("Cannot fetch accelerometer sample: %d\n", ret);
		return ret;
	}

	ret = sensor_channel_get(dev, SENSOR_CHAN_ACCEL_XYZ, accel);
	k_mutex_unlock(&sensor_lock);
	if (ret < 0) {
		printk("Cannot read accelerometer channel: %d\n", ret);
		return ret;
	}

	return 0;
}

static void enqueue_accel_sample(struct app_context *ctx, const struct accel_sample *sample)
{
	struct accel_sample dropped;

	if (!sensor_drdy_reserve_accel_in(sample->timestamp_us)) {
		return;
	}

	k_mutex_lock(&app_lock, K_FOREVER);
	memcpy(ctx->accel, sample->accel, sizeof(ctx->accel));
	if (sample->late_us > 0U) {
		ctx->accel_late_samples++;
		if (sample->late_us > ctx->accel_max_late_us) {
			ctx->accel_max_late_us = sample->late_us;
		}
	}
	k_mutex_unlock(&app_lock);

	if (k_msgq_put(&accel_msgq, sample, K_NO_WAIT) == 0) {
		return;
	}

	/* Cyclic buffering policy: make room by discarding the oldest sample. */
	if (k_msgq_get(&accel_msgq, &dropped, K_NO_WAIT) == 0 &&
	    k_msgq_put(&accel_msgq, sample, K_NO_WAIT) == 0) {
		k_mutex_lock(&app_lock, K_FOREVER);
		ctx->accel_queue_drops++;
		k_mutex_unlock(&app_lock);
	}
}

void task_accel_sample(struct app_context *ctx, uint64_t timestamp_us, uint32_t late_us)
{
	uint16_t fifo_samples;

	sensor_drdy_poll_accel();

	if (lsm6dsl_fifo_sample_count(&fifo_samples) == 0) {
		if (fifo_samples == 0U) {
			return;
		}

		for (uint16_t i = 0U; i < fifo_samples; i++) {
			uint64_t sample_age_us =
				(uint64_t)(fifo_samples - 1U - i) * ACCEL_INTERVAL_BASE_US;
			struct accel_sample sample = {
				.timestamp_us = (timestamp_us > sample_age_us) ?
						timestamp_us - sample_age_us : 0U,
				.late_us = (i == 0U) ? late_us : 0U,
			};

			if (lsm6dsl_fifo_read_accel(sample.accel) < 0) {
				return;
			}

			enqueue_accel_sample(ctx, &sample);
		}

		return;
	}

	/*
	 * If FIFO status cannot be read, keep the accel path alive by reading
	 * the current output registers once.
	 */
	struct accel_sample sample = {
		.timestamp_us = timestamp_us,
		.late_us = late_us,
	};

	if (read_current_accel(ctx->lsm6dsl_dev, sample.accel) != 0) {
		return;
	}

	enqueue_accel_sample(ctx, &sample);
}

void task_read_hts221(struct app_context *ctx)
{
	int ret;
	struct sensor_value humidity;
	struct sensor_value temperature;

	sensor_drdy_poll_hts221();

	k_mutex_lock(&sensor_lock, K_FOREVER);
	ret = sensor_sample_fetch(ctx->hts221_dev);
	if (ret < 0) {
		k_mutex_unlock(&sensor_lock);
		printk("HTS221 fetch failed: %d\n", ret);
		return;
	}

	ret = sensor_channel_get(ctx->hts221_dev, SENSOR_CHAN_HUMIDITY, &humidity);
	if (ret < 0) {
		k_mutex_unlock(&sensor_lock);
		printk("HTS221 humidity read failed: %d\n", ret);
		return;
	}

	ret = sensor_channel_get(ctx->hts221_dev, SENSOR_CHAN_AMBIENT_TEMP, &temperature);
	k_mutex_unlock(&sensor_lock);
	if (ret < 0) {
		printk("HTS221 temperature read failed: %d\n", ret);
		return;
	}

	k_mutex_lock(&app_lock, K_FOREVER);
	ctx->humidity = humidity;
	ctx->temperature = temperature;
	k_mutex_unlock(&app_lock);
}

void task_read_gyro(struct app_context *ctx)
{
	int ret;
	struct sensor_value gyro[3];

	sensor_drdy_poll_gyro();

	k_mutex_lock(&sensor_lock, K_FOREVER);
	ret = sensor_sample_fetch_chan(ctx->lsm6dsl_dev, SENSOR_CHAN_GYRO_XYZ);
	if (ret < 0) {
		k_mutex_unlock(&sensor_lock);
		printk("LSM6DSL gyro fetch failed: %d\n", ret);
		return;
	}

	ret = sensor_channel_get(ctx->lsm6dsl_dev, SENSOR_CHAN_GYRO_XYZ, gyro);
	k_mutex_unlock(&sensor_lock);
	if (ret < 0) {
		printk("LSM6DSL gyro read failed: %d\n", ret);
		return;
	}

	k_mutex_lock(&app_lock, K_FOREVER);
	memcpy(ctx->gyro, gyro, sizeof(ctx->gyro));
	k_mutex_unlock(&app_lock);
}

void task_read_lis3mdl(struct app_context *ctx)
{
	int ret;
	struct sensor_value magnetic[3];

	sensor_drdy_poll_lis3mdl();

	k_mutex_lock(&sensor_lock, K_FOREVER);
	ret = sensor_sample_fetch(ctx->lis3mdl_dev);
	if (ret < 0) {
		k_mutex_unlock(&sensor_lock);
		printk("LIS3MDL fetch failed: %d\n", ret);
		return;
	}

	ret = sensor_channel_get(ctx->lis3mdl_dev, SENSOR_CHAN_MAGN_XYZ, magnetic);
	k_mutex_unlock(&sensor_lock);
	if (ret < 0) {
		printk("LIS3MDL read failed: %d\n", ret);
		return;
	}

	k_mutex_lock(&app_lock, K_FOREVER);
	memcpy(ctx->magnetic, magnetic, sizeof(ctx->magnetic));
	k_mutex_unlock(&app_lock);
}

void task_read_lps22hb(struct app_context *ctx)
{
	int ret;
	struct sensor_value pressure;

	sensor_drdy_poll_lps22hb();

	k_mutex_lock(&sensor_lock, K_FOREVER);
	ret = sensor_sample_fetch(ctx->lps22hb_dev);
	if (ret < 0) {
		k_mutex_unlock(&sensor_lock);
		printk("LPS22HB fetch failed: %d\n", ret);
		return;
	}

	ret = sensor_channel_get(ctx->lps22hb_dev, SENSOR_CHAN_PRESS, &pressure);
	k_mutex_unlock(&sensor_lock);
	if (ret < 0) {
		printk("LPS22HB pressure read failed: %d\n", ret);
		return;
	}

	k_mutex_lock(&app_lock, K_FOREVER);
	ctx->pressure = pressure;
	k_mutex_unlock(&app_lock);
}
```

## src/sensor_tasks.h
```c
#ifndef APPLICATIONS_LSM6DSL_SENSOR_TASKS_H_
#define APPLICATIONS_LSM6DSL_SENSOR_TASKS_H_

#include "app_context.h"

void task_accel_sample(struct app_context *ctx, uint64_t timestamp_us, uint32_t late_us);
void task_read_gyro(struct app_context *ctx);
void task_read_hts221(struct app_context *ctx);
void task_read_lis3mdl(struct app_context *ctx);
void task_read_lps22hb(struct app_context *ctx);

#endif
```

## src/status.c
```c
#include "status.h"

#include <zephyr/sys/printk.h>
#include <stdarg.h>

#include "sensor_drdy.h"

static char status_msg[STATUS_MSG_SIZE];
static char drdy_msg[192];

static const char *const har_labels[3] = {
	"stationary",
	"walking",
	"running",
};

static void append_fmt(char *buf, size_t buf_size, size_t *offset, const char *fmt, ...)
{
	va_list args;
	int written;

	if (*offset >= buf_size) {
		return;
	}

	va_start(args, fmt);
	written = vsnprintk(buf + *offset, buf_size - *offset, fmt, args);
	va_end(args);

	if (written < 0) {
		return;
	}

	*offset += (size_t)written;
}

static void append_text(char *buf, size_t buf_size, size_t *offset, const char *text)
{
	append_fmt(buf, buf_size, offset, "%s", text);
}

static void append_sensor_value(char *buf, size_t buf_size, size_t *offset,
			       const struct sensor_value *value)
{
	/* Zephyr sensor values store the fractional part in micro-units. */
	int64_t micro = (int64_t)value->val1 * 1000000LL + value->val2;

	if (*offset >= buf_size) {
		return;
	}

	if (micro < 0) {
		append_fmt(buf, buf_size, offset, "-%lld.%06lld",
			  -micro / 1000000LL, -micro % 1000000LL);
	} else {
		append_fmt(buf, buf_size, offset, "%lld.%06lld",
			  micro / 1000000LL, micro % 1000000LL);
	}
}

static void append_score(char *buf, size_t buf_size, size_t *offset, float value)
{
	int scaled = (int)(value * 1000.0f + 0.5f);

	if (*offset >= buf_size) {
		return;
	}

	if (scaled < 0) {
		scaled = 0;
	}

	append_fmt(buf, buf_size, offset, "%d.%03d", scaled / 1000, scaled % 1000);
}

void task_print_status(struct app_context *ctx)
{
	size_t len = 0;
	struct app_context snapshot;

	sensor_drdy_format_report(drdy_msg, sizeof(drdy_msg), app_now_us());
	if (drdy_msg[0] != '\0') {
		printk("%s", drdy_msg);
		return;
	}

	k_mutex_lock(&app_lock, K_FOREVER);
	snapshot = *ctx;
	k_mutex_unlock(&app_lock);

	append_fmt(status_msg, sizeof(status_msg), &len, "t=%llu ms | hum=",
		  (unsigned long long)k_uptime_get());
	append_sensor_value(status_msg, sizeof(status_msg), &len, &snapshot.humidity);
	append_text(status_msg, sizeof(status_msg), &len, " % | temp=");
	append_sensor_value(status_msg, sizeof(status_msg), &len, &snapshot.temperature);
	append_text(status_msg, sizeof(status_msg), &len, " C | press=");
	append_sensor_value(status_msg, sizeof(status_msg), &len, &snapshot.pressure);
	append_text(status_msg, sizeof(status_msg), &len, " kPa | gyro=(");
	append_sensor_value(status_msg, sizeof(status_msg), &len, &snapshot.gyro[0]);
	append_text(status_msg, sizeof(status_msg), &len, ",");
	append_sensor_value(status_msg, sizeof(status_msg), &len, &snapshot.gyro[1]);
	append_text(status_msg, sizeof(status_msg), &len, ",");
	append_sensor_value(status_msg, sizeof(status_msg), &len, &snapshot.gyro[2]);
	append_text(status_msg, sizeof(status_msg), &len, ") rad/s | mag=(");
	append_sensor_value(status_msg, sizeof(status_msg), &len, &snapshot.magnetic[0]);
	append_text(status_msg, sizeof(status_msg), &len, ",");
	append_sensor_value(status_msg, sizeof(status_msg), &len, &snapshot.magnetic[1]);
	append_text(status_msg, sizeof(status_msg), &len, ",");
	append_sensor_value(status_msg, sizeof(status_msg), &len, &snapshot.magnetic[2]);
	append_text(status_msg, sizeof(status_msg), &len, ") gauss | har=");

	if (snapshot.har_status == 0) {
		append_text(status_msg, sizeof(status_msg), &len, har_labels[0]);
		append_text(status_msg, sizeof(status_msg), &len, ":");
		append_score(status_msg, sizeof(status_msg), &len, snapshot.har_scores[0]);
		append_text(status_msg, sizeof(status_msg), &len, ",");
		append_text(status_msg, sizeof(status_msg), &len, har_labels[1]);
		append_text(status_msg, sizeof(status_msg), &len, ":");
		append_score(status_msg, sizeof(status_msg), &len, snapshot.har_scores[1]);
		append_text(status_msg, sizeof(status_msg), &len, ",");
		append_text(status_msg, sizeof(status_msg), &len, har_labels[2]);
		append_text(status_msg, sizeof(status_msg), &len, ":");
		append_score(status_msg, sizeof(status_msg), &len, snapshot.har_scores[2]);
		append_fmt(status_msg, sizeof(status_msg), &len,
			  " | infer=%llu.%03llu ms | qdrop=%u late=%u maxlate=%u us urgent=%u/%u us\n",
			  (unsigned long long)(snapshot.har_us / 1000ULL),
			  (unsigned long long)(snapshot.har_us % 1000ULL),
			  snapshot.accel_queue_drops,
			  snapshot.accel_late_samples,
			  snapshot.accel_max_late_us,
			  snapshot.urgent_events,
			  snapshot.urgent_last_block_us);
	} else {
		append_fmt(status_msg, sizeof(status_msg), &len, "waiting(%d/%d)\n",
			  (int)snapshot.har_sample_count, HAR_WINDOW_SAMPLES);
	}

	if (len >= sizeof(status_msg)) {
		len = sizeof(status_msg) - 1;
		status_msg[len] = '\0';
	}

	printk("%s", status_msg);
}
```
